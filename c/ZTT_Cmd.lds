/*SECTIONS
{
    _ZTT_CMD_TABLE_START = .;
    .ZTT_CMD_TABLE : { *(.ZTT_CMD_TABLE) }
    _ZTT_CMD_TABLE_END = .;
}
*/
SECTIONS
{    
    .ZTT_CMD_TABLE ALIGN(64) : { KEEP(*(.ZTT_CMD_TABLE)) }
    PROVIDE(_ZTT_CMD_TABLE_START = ADDR(.ZTT_CMD_TABLE));
    PROVIDE(_ZTT_CMD_TABLE_END   = ADDR(.ZTT_CMD_TABLE) + SIZEOF(.ZTT_CMD_TABLE));
}

INSERT AFTER .rodata
